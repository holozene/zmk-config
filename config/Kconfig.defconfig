## config/Kconfig.defconfig
```kconfig
if SHIELD_ANTHRO_LEFT

config ZMK_KEYBOARD_NAME
    default "Anthro"

config ZMK_SPLIT_ROLE_CENTRAL
    default y

endif

if SHIELD_ANTHRO_LEFT || SHIELD_ANTHRO_RIGHT

config ZMK_SPLIT
    default y

endif
```

## config/boards/shields/anthro/Kconfig.shield
```kconfig
config SHIELD_ANTHRO_LEFT
    def_bool $(shields_list_contains,anthro_left)

config SHIELD_ANTHRO_RIGHT
    def_bool $(shields_list_contains,anthro_right)
```
