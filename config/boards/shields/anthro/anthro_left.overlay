#include "anthro.dtsi"

&kscan_up {
	// left half:
	row-gpios = <&pro_micro 1 (GPIO_ACTIVE_HIGH | GPIO_PULL_DOWN)>, // top
		        <&pro_micro 16 (GPIO_ACTIVE_HIGH | GPIO_PULL_DOWN)>, // home
		        <&pro_micro 10 (GPIO_ACTIVE_HIGH | GPIO_PULL_DOWN)>, // bottom
				//													    thumb
		        <&pro_micro 0  (GPIO_ACTIVE_HIGH | GPIO_PULL_DOWN)>, // high
		        <&pro_micro 2  (GPIO_ACTIVE_HIGH | GPIO_PULL_DOWN)>; // low

    col-gpios = <&pro_micro 21 (GPIO_ACTIVE_HIGH | GPIO_PULL_DOWN)>, // 0 outer
				<&pro_micro 20 (GPIO_ACTIVE_HIGH | GPIO_PULL_DOWN)>, // 1 pinky
				<&pro_micro 19 (GPIO_ACTIVE_HIGH | GPIO_PULL_DOWN)>, // 2 ring
				<&pro_micro 15 (GPIO_ACTIVE_HIGH | GPIO_PULL_DOWN)>, // 3 middle
				<&pro_micro 18 (GPIO_ACTIVE_HIGH | GPIO_PULL_DOWN)>, // 4 index
				<&pro_micro 9  (GPIO_ACTIVE_HIGH | GPIO_PULL_DOWN)>, // 5 inner
				//                                                        thumb
				<&pro_micro 3  (GPIO_ACTIVE_HIGH | GPIO_PULL_DOWN)>, // 6 near
				<&pro_micro 4  (GPIO_ACTIVE_HIGH | GPIO_PULL_DOWN)>, // 7 home
				<&pro_micro 5  (GPIO_ACTIVE_HIGH | GPIO_PULL_DOWN)>, // 8 mid
				<&pro_micro 6  (GPIO_ACTIVE_HIGH | GPIO_PULL_DOWN)>; // 9 far
	
};
// 7 is missing