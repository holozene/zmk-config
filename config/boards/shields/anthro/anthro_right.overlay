#include "anthro.dtsi"

&default_transform { // The matrix transform for this board is 10 columns over because the left half is 10 columns wide according to the matrix.
    col-offset = <10>;
};

&kscan_up {
	// right half:
	row-gpios = <&pro_micro 7  (GPIO_ACTIVE_HIGH | GPIO_PULL_DOWN)>, // top
		        <&pro_micro 8  (GPIO_ACTIVE_HIGH | GPIO_PULL_DOWN)>, // home
		        <&pro_micro 9  (GPIO_ACTIVE_HIGH | GPIO_PULL_DOWN)>, // bottom
				//													    thumb
		        <&pro_micro 16 (GPIO_ACTIVE_HIGH | GPIO_PULL_DOWN)>, // high
		        <&pro_micro 21 (GPIO_ACTIVE_HIGH | GPIO_PULL_DOWN)>; // low

    col-gpios = //                                                         thumb
				<&pro_micro 15 (GPIO_ACTIVE_HIGH | GPIO_PULL_DOWN)>; // 10 far
				<&pro_micro 18 (GPIO_ACTIVE_HIGH | GPIO_PULL_DOWN)>, // 11 mid
				<&pro_micro 19 (GPIO_ACTIVE_HIGH | GPIO_PULL_DOWN)>, // 12 home
				<&pro_micro 20 (GPIO_ACTIVE_HIGH | GPIO_PULL_DOWN)>, // 13 near
				//                                                         main
				<&pro_micro 10 (GPIO_ACTIVE_HIGH | GPIO_PULL_DOWN)>, // 14 inner
				<&pro_micro 5  (GPIO_ACTIVE_HIGH | GPIO_PULL_DOWN)>, // 15 index
				<&pro_micro 6  (GPIO_ACTIVE_HIGH | GPIO_PULL_DOWN)>, // 16 middle
				<&pro_micro 4  (GPIO_ACTIVE_HIGH | GPIO_PULL_DOWN)>, // 17 ring
				<&pro_micro 3  (GPIO_ACTIVE_HIGH | GPIO_PULL_DOWN)>, // 18 pinky
				<&pro_micro 2  (GPIO_ACTIVE_HIGH | GPIO_PULL_DOWN)>, // 19 outer
};
 // 14 is missing